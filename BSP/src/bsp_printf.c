/*
*********************************************************************************************************
* @file    	bsp_printf.c
* @author  	SY
* @version 	V1.0.1
* @date    	2017-1-13 09:33:05
* @IDE	 	Keil V4.72.10.0
* @Chip    	STM32F407VE
* @brief   	printf源文件
*********************************************************************************************************
* @attention
* =======================================================================================================
*	版本 		时间					作者					说明
* -------------------------------------------------------------------------------------------------------
*	Ver1.0.1 	2017-2-9 14:26:09 		SY		1、__ECHO()、ECHO_SAFE()函数，在打印大量数据时，由于函数
												使用了数组，占用了大量的堆栈空间。如果该函数没有退出，又被
												又被其他函数调用，将导致上次堆栈未被释放，本次又占用了
												堆栈空间，当堆栈溢出后，将导致单片机进入硬件中断。
												因此，推荐直接使用printf()函数打印输出信息。
												2、凡是OSXXXPend类的函数，一律禁止在中断里面调用。
*
*********************************************************************************************************
*/

/*
*********************************************************************************************************
*                              				Private Includes
*********************************************************************************************************
*/
#include "bsp.h"


/*
*********************************************************************************************************
*                              				Private define
*********************************************************************************************************
*/


/*
*********************************************************************************************************
*                              				Private typedef
*********************************************************************************************************
*/

/*
*********************************************************************************************************
*                              				Private constants
*********************************************************************************************************
*/

/*
*********************************************************************************************************
*                              				Private macro
*********************************************************************************************************
*/

/*
*********************************************************************************************************
*                              				Private variables
*********************************************************************************************************
*/

/*
*********************************************************************************************************
*                              				Private function prototypes
*********************************************************************************************************
*/

/*
*********************************************************************************************************
*                              				Private functions
*********************************************************************************************************
*/
/*
*********************************************************************************************************
* Function Name : fputc
* Description	: 重定义putc函数，这样可以使用printf函数从串口1打印输出
* Input			: None
* Output		: None
* Return		: None
*********************************************************************************************************
*/
int fputc(int ch, FILE *f)
{
	#if 1	/* 将需要printf的字符通过串口中断FIFO发送出去，printf函数会立即返回 */
		//bsp_COM_Write(DEBUG_COM,(uint8_t *)&ch,1);
	
		return ch;
	#else	/* 采用阻塞方式发送每个字符,等待数据发送完毕 */
		/* 写一个字节到USART1 */
		USART_SendData(USART1, (uint8_t) ch);
		/* 等待发送结束 */
		while (USART_GetFlagStatus(USART1, USART_FLAG_TC) == RESET)
		{
			;
		}
		return ch;
	#endif
}

#if 0
/*
*********************************************************************************************************
*	函 数 名: fgetc
*	功能说明: 重定义getc函数，这样可以使用getchar函数从串口1输入数据
*	形    参: 无
*	返 回 值: 无
*********************************************************************************************************
*/
int fgetc(FILE *f)
{
#if 1	/* 从串口接收FIFO中取1个数据, 只有取到数据才返回 */
	uint8_t ucData;

	while(bsp_COM_Read(DEBUG_COM, &ucData) == 0)
	{
		bsp_DelayMS(100);
	}

	return ucData;
#else
	/* 等待串口1输入数据 */
	while (USART_GetFlagStatus(USART1, USART_FLAG_RXNE) == RESET);

	return (int)USART_ReceiveData(USART1);
#endif
}
#endif

/************************ (C) COPYRIGHT STMicroelectronics **********END OF FILE*************************/
